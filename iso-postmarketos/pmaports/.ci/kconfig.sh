## iso-postmarketos/pmaports/device/archived/device-linksys-jamaica/boot-image.its
```
/dts-v1/;

/ {
        description = "a";
        #address-cells = <1>;

        images {
                kernel {
                        description = "Kernel";
                        data = /incbin/("vmlinuz");
                        type = "kernel";
                        arch = "arm";
                        os = "linux";
                        compression = "none";
                        load = <0x41208000>;
                        entry = <0x41208000>;
                };
                fdt {
                        description = "DTB";
                        data = /incbin/("/boot/dtbs/qcom-ipq5018-linksys-jamaica.dtb");
                        type = "flat_dt";
                        arch = "arm";
                        compression = "none";
                };
		initrd {
			description = "Initramfs image";
			data = /incbin/("initramfs");
			type = "ramdisk";
			arch = "arm";
			os = "linux";
		};

        };

        configurations {
                default = "standard";
                standard {
                        description = "Standard Boot";
                        kernel = "kernel";
                        fdt = "fdt";
			ramdisk = "initrd";
                };
        };

};    
```

## iso-postmarketos/pmaports/device/community/device-samsung-starqltechn/boot_image.its
```
/dts-v1/;

/ {
        description = "Samsung S9 SM-G9600 starqltechn FIT Image";
        #address-cells = <1>;

        images {
                bootscript {
                        description = "Boot script";
                        data = /incbin/("bootscript.sh");
                        type = "script";
                        compression = "none";
                        load = <0x90000000>;
                        entry = <0x90000000>;
                        hash {
                                algo = "sha1";
                        };
                };
                prebootscript {
                        description = "Boot script";
                        data = /incbin/("bootscript.sh");
                        type = "script";
                        compression = "none";
                        load = <0x90000000>;
                        entry = <0x90000000>;
                        hash {
                                algo = "sha1";
                        };
                };
                kernel {
                        description = "Kernel";
                        data = /incbin/("vmlinuz");
                        type = "kernel";
                        arch = "arm64";
                        os = "linux";
                        compression = "gzip";
                        load = <0x80000000>;
                        entry = <0x80000000>;
                        hash {
                                algo = "sha1";
                        };
                };
                fdt {
                        description = "DTB";
                        data = /incbin/("/boot/dtbs/qcom/sdm845-samsung-starqltechn.dtb");
                        type = "flat_dt";
                        arch = "arm64";
                        compression = "none";
                        load = <0x83700000>;
                        entry = <0x83700000>;
                        hash {
                                algo = "sha1";
                        };
                };
                initrd {
                        description = "Initrd";
                        compression = "none";
                        data = /incbin/("initramfs");
                        type = "ramdisk";
                        arch = "arm64";
                        os = "linux";
                        hash {
                                algo = "sha1";
                        };
                };
        };

        configurations {
                default = "standard";
                standard {
                        description = "Standard Boot";
                        kernel = "kernel";
                        fdt = "fdt";
                        ramdisk = "initrd";
                        hash {
                                algo = "sha1";
                        };
                };
        };
};
```

## iso-postmarketos/pmaports/device/testing/device-amlogic-aarch64-tvbox/boot-image.its
```
/dts-v1/;

/ {
	description = "Amlogic Generic TV Box FIT Image";
	#address-cells = <1>;

	images {
		kernel {
			description = "Kernel";
			data = /incbin/("vmlinuz");
			type = "kernel";
			arch = "arm64";
			os = "linux";
			compression = "none";
			load = <0x1080000>;
			entry = <0x1080000>;
		};
		fdt {
			description = "DTB";
			data = /incbin/("[[[DEVICETREE]]]");
			type = "flat_dt";
			compression = "none";
			arch = "arm64";
		};
		initrd {
			description = "Initramfs image";
			data = /incbin/("initramfs");
			type = "ramdisk";
			arch = "arm64";
			os = "linux";
		};

	};

	configurations {
		default = "standard";
		standard {
			description = "Standard Boot";
			kernel = "kernel";
			fdt = "fdt";
			ramdisk = "initrd";
		};
	};

};
```

## iso-postmarketos/pmaports/device/testing/device-samsung-grandpplte/boot-image.its
```
/dts-v1/;

/ {
	description = "Samsung Galaxy Grand Prime+ FIT";
	#address-cells = <1>;

	images {
		bootscript {
			description = "Boot script";
			data = /incbin/("boot.cmd");
			type = "script";
			compression = "none";
		};

		kernel {
			description = "Linux kernel";
			data = /incbin/("vmlinuz");
			type = "kernel";
			arch = "arm64";
			os = "linux";
			compression = "gzip";
			load = <0x40080000>;
			entry = <0x40080000>;
		};

		fdt {
			description = "Device tree";
			data = /incbin/("/boot/dtbs/mediatek/mt6737t-samsung-grandpplte.dtb");
			type = "flat_dt";
			compression = "none";
		};

		initrd {
			description = "Initramfs image";
			data = /incbin/("initramfs");
			type = "ramdisk";
			arch = "arm64";
			os = "linux";
		};
	};

	configurations {
		default = "standard";

		standard {
			description = "Standard boot";
			kernel = "kernel";
			fdt = "fdt";
			ramdisk = "initrd";
		};
	};
};
```
